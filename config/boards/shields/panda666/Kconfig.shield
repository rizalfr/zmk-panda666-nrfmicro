## config/boards/shields/panda666/Kconfig.shield
```kconfig
# Copyright (c) 2020 The ZMK Contributors
# SPDX-License-Identifier: MIT

config SHIELD_PANDA666
    def_bool $(shields_list_contains,panda666)
```
